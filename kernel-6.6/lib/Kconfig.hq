## kernel-6.6/lib/Kconfig.hq
```kconfig
# SPDX-License-Identifier: GPL-2.0-only

config ODM_CUSTOM_BUILD
    bool "CONFIG ODM CUSTOM BUILD"

config ODM_CUSTOM_FACTORY_BUILD
    bool "CONFIG ODM CUSTOM FACTORY BUILD"

config ODM_CUSTOM_D85_BUILD
    bool "CONFIG ODM CUSTOM D85 BUILD"

config HUAQIN_BUILD
    bool "CONFIG HUAQIN BUILD"

config HQ_FACTORY_BUILD
    bool "CONFIG HQ FACTORY BUILD"

config HQ_D85_BUILD
    bool "CONFIG HQ D85 BUILD"

config HQ_PROJECT_O22
    bool "CONFIG HQ PROJECT O22"

config HQ_PROJECT_O8
    bool "CONFIG HQ PROJECT O8"
```

## kernel/kernel_device_modules-6.6/drivers/input/touchscreen/Kconfig
```kconfig
# SPDX-License-Identifier: GPL-2.0-only
#
# Touchscreen driver configuration
#

if INPUT_TOUCHSCREEN

config TOUCHSCREEN_MTK_TOUCH
       string "Touch IC name for Mediatek package"
       help
         Set touch IC name if you have touch panel.

         To compile this dirver for used touch IC.

config TOUCHSCREEN_MT6985_ALPHA_SUPPORT
       tristate "Specify Alpha Touch Platform is mt6985"
       help
         Select Alpha Touch Platform is mt6985.
         To compile this dirver for used touch IC.
         Set Y or M to select this feature for specific platform-mt6985,
         and set N to disable.

config TOUCHSCREEN_ILITEK_TOUCH
       tristate "ILITEK TOUCHSCREEN"
       help
         Set Y or M to select this feature for touch compile,
         and set N to disable.

config TOUCHSCREEN_BOTAI_MULTI_TOUCH
       tristate "GT9XX MULTIPLE TOUCHSCREEN"
       help
         Set Y or M to select this feature for touch compile,
         and set N to disable.for BoTai touch feature.

config TOUCHSCREEN_GT9XX
       tristate "GT9XX TOUCHSCREEN FOR CAR SERDES TOUCH"
       help
         Set Y or M to select this feature for touch compile,
         and set N to disable.for car serdes touch feature.

config TOUCHSCREEN_FOCALTECH_TOUCH
       tristate "FOCALTECH TOUCHSCREEN"
       help
         Set Y or M to select this feature for touch compile,
         and set N to disable.for car serdes touch feature.

source "$(KCONFIG_EXT_PREFIX)drivers/input/touchscreen/BoTai_Multi_Touch/Kconfig"
source "$(KCONFIG_EXT_PREFIX)drivers/input/touchscreen/GT9966/Kconfig"
source "$(KCONFIG_EXT_PREFIX)drivers/input/touchscreen/gt9xx/Kconfig"
source "$(KCONFIG_EXT_PREFIX)drivers/input/touchscreen/ILITEK/Kconfig"
source "$(KCONFIG_EXT_PREFIX)drivers/input/touchscreen/synaptics_dsx_96789/Kconfig"
source "$(KCONFIG_EXT_PREFIX)drivers/input/touchscreen/synaptics_dsx_96851/Kconfig"
source "$(KCONFIG_EXT_PREFIX)drivers/input/touchscreen/NT36532/Kconfig"
source "$(KCONFIG_EXT_PREFIX)drivers/input/touchscreen/gt9895_brl/Kconfig"
source "$(KCONFIG_EXT_PREFIX)drivers/input/touchscreen/synaptics_tcm2_sec/Kconfig"
source "$(KCONFIG_EXT_PREFIX)drivers/input/touchscreen/GT6936/Kconfig"
# a06 code for SR-AL7160V-01-62 by wenghailong at 20240826 start
if HQ_PROJECT_O8
source "$(KCONFIG_EXT_PREFIX)drivers/input/touchscreen/O8/touch_common/Kconfig"
source "$(KCONFIG_EXT_PREFIX)drivers/input/touchscreen/O8/focaltech_touch_ft8057p/Kconfig"
source "$(KCONFIG_EXT_PREFIX)drivers/input/touchscreen/O8/hxchipset_hx83108b/Kconfig"
source "$(KCONFIG_EXT_PREFIX)drivers/input/touchscreen/O8/galaxycore/Kconfig"
endif#HQ_PROJECT_O8
# a06 code for SR-AL7160V-01-62 by wenghailong at 20240826 end
# o22 code for SR-AL6528V-01-137 by wanglei at 20240901 start
if HQ_PROJECT_O22
source "$(KCONFIG_EXT_PREFIX)drivers/input/touchscreen/O22/touch_common/Kconfig"
source "$(KCONFIG_EXT_PREFIX)drivers/input/touchscreen/O22/omnivision_tcm/Kconfig"
source "$(KCONFIG_EXT_PREFIX)drivers/input/touchscreen/O22/hxchipset/Kconfig"
source "$(KCONFIG_EXT_PREFIX)drivers/input/touchscreen/O22/jdchipset/Kconfig"
source "$(KCONFIG_EXT_PREFIX)drivers/input/touchscreen/O22/chipone-tddi/Kconfig"
endif#HQ_PROJECT_O22
# o22 code for SR-AL6528V-01-137 by wanglei at 20240901 end
endif
```

## kernel/kernel_device_modules-6.6/drivers/input/touchscreen/O22/hxchipset/Kconfig
```kconfig
#
# Himax Touchscreen driver configuration
#
config TOUCHSCREEN_HIMAX_CHIPSET_O22
    tristate "HIMAX chipset touchscreen"
    default m
    depends on SPI
    help
        Say Y here if you have a Himax CHIPSET touch panel
        If unsure, say N.

config TOUCHSCREEN_HIMAX_IC_HX83112
    bool "HIMAX chipset HX83112 function"
    depends on TOUCHSCREEN_HIMAX_CHIPSET_O22
    help
        This enables support for HIMAX CHIPSET of HX83112.

config TOUCHSCREEN_HIMAX_COMMON
        bool "HIMAX common function"
        depends on TOUCHSCREEN_HIMAX_CHIPSET_O22
        help
        This enables support for HIMAX COMMON touchscreens.

config TOUCHSCREEN_HIMAX_SEC
        bool "HIMAX sec function"
        depends on TOUCHSCREEN_HIMAX_CHIPSET_O22
        help
        This enables support for HIMAX sec touchscreens.

config TOUCHSCREEN_HIMAX_INCELL
        bool "HIMAX chipset in-cell function"
        depends on TOUCHSCREEN_HIMAX_CHIPSET_O22
        help
        This enables support for HIMAX CHIPSET of in-cell function.

config TOUCHSCREEN_HIMAX_DEBUG
        bool "HIMAX debug function"
        depends on TOUCHSCREEN_HIMAX_CHIPSET_O22
        help
        This enables support for HIMAX debug function.

config TOUCHSCREEN_HIMAX_INSPECT
        bool "HIMAX inspect function"
        depends on TOUCHSCREEN_HIMAX_CHIPSET_O22
        help
        This enables support for HIMAX inspect function.

config TOUCHSCREEN_HIMAX_EMBEDDED_FIRMWARE
        bool "HIMAX embedded firmware function"
        depends on TOUCHSCREEN_HIMAX_CHIPSET_O22
        help
        This enables support for HIMAX embedded firmware function.
```

## kernel/kernel_device_modules-6.6/drivers/input/touchscreen/O22/jdchipset/Kconfig
```kconfig
#
# Jadard Touchscreen driver configuration
#
config TOUCHSCREEN_JADARD_CHIPSET_O22
    tristate "Jadard chipset module fuction"
    default m
    help
        Say Y here if you have GCORE touch panel
        If unsure, say N.

config TOUCHSCREEN_JADARD_MODULE
    bool "Jadard chipset module fuction"
    depends on TOUCHSCREEN_JADARD_CHIPSET_O22
    help
      This switch whether to compile into a kernel module.

config TOUCHSCREEN_JADARD_IC_JD9522T
    bool "Jadard chipset of JD9522T"
    depends on TOUCHSCREEN_JADARD_CHIPSET_O22
    help
      This enables support for Jadard chipset of JD9522T.

config JD_FB
    bool "Jadard driver suspend/resume event by system FB"
    depends on TOUCHSCREEN_JADARD_CHIPSET_O22
    help
      This enables support for Jadard driver suspend/resume event by system FB.

config TOUCHSCREEN_JADARD_COMMON
    bool "Jadard chipset common fuction"
    depends on TOUCHSCREEN_JADARD_CHIPSET_O22
    help
      This enables support for Jadard chipset common function.

config TOUCHSCREEN_JADARD_DEBUG
    bool "Jadard chipset debug function"
    depends on TOUCHSCREEN_JADARD_CHIPSET_O22
    help
      This enables support for Jadard chipset debug function.

config TOUCHSCREEN_JADARD_SORTING
    bool "Jadard chipset sorting function"
    depends on TOUCHSCREEN_JADARD_CHIPSET_O22
    help
      This enables support for Jadard chipset sorting function.
```

## kernel/kernel_device_modules-6.6/drivers/input/touchscreen/O22/touch_common/Kconfig
```kconfig
#
# Common Touchscreen driver configuration
#
config ODM_SEC_COMMON_O22
    tristate "For Common TOUCH"
    default m
    help
        Say Y here if you have common touch panel

        If unsure, say N.
```

## kernel/kernel_device_modules-6.6/drivers/input/touchscreen/O8/galaxycore/Kconfig
```kconfig
#
# GC7272 Touchscreen driver configuration
#

config TOUCHSCREEN_GALAXYCORE_IC_GC7272_O8
    tristate "For GALAXYCORE TOUCH"
    default m
    help
        Say Y here if you have GCORE touch panel

        If unsure, say N.
```

## kernel/kernel_device_modules-6.6/drivers/input/touchscreen/O8/hxchipset_hx83108b/Kconfig
```kconfig
#
# Himax Touchscreen driver configuration
#

config TOUCHSCREEN_HX83108B_CHIPSET_O8
    tristate "For HX83108B_CHIPSET TOUCH"
    default m
    depends on SPI
    help
        Say Y here if you have a Himax CHIPSET touchscreen.
        HIMAX controllers are multi touch controllers which can
        report 10 touches at a time.
        If unsure, say N.

config TOUCHSCREEN_HIMAX_IC_HX83108A_O8
    bool "HIMAX chipset HX83108A function"
    depends on TOUCHSCREEN_HX83108B_CHIPSET_O8
    help
        This enables support for HIMAX CHIPSET of HX83108A.

config TOUCHSCREEN_HIMAX_DEBUG_O8
    bool "HIMAX debug function"
    depends on TOUCHSCREEN_HX83108B_CHIPSET_O8
    help
        This enables support for HIMAX debug function.

config TOUCHSCREEN_HIMAX_INSPECT_O8
    bool "HIMAX inspect function"
    depends on TOUCHSCREEN_HX83108B_CHIPSET_O8
    help
        This enables support for HIMAX inspect function.
```

## kernel/kernel_device_modules-6.6/drivers/input/touchscreen/O8/touch_common/Kconfig
```kconfig
#
# Common Touchscreen driver configuration
#
config ODM_SEC_COMMON_O8
    tristate "For Common TOUCH"
    default m
    help
        Say Y here if you have common touch panel

        If unsure, say N.
```

## kernel/kernel_device_modules-6.6/drivers/misc/Kconfig
```kconfig
# SPDX-License-Identifier: GPL-2.0-only

source "drivers/misc/mediatek/Kconfig"

# A06_V code added for SR-AL5625-01-233 by zhengchao at 20240826 start
source "drivers/misc/huaqin/Kconfig"
# A06_V code added for SR-AL5625-01-233 by zhengchao at 20240826 end

source "drivers/misc/drb/Kconfig"
```

## kernel/kernel_device_modules-6.6/drivers/misc/drb/Kconfig
```kconfig
# SPDX-License-Identifier: GPL-2.0-only

config DEV_RIL_BRIDGE
	tristate "Support a bridge between device and RIL"
	default n
```

## kernel/kernel_device_modules-6.6/drivers/misc/mediatek/KnoxVault/Kconfig
```kconfig
config KNOXVAULT_POWER
    tristate "regulate control of KnoxVault2"
    default n
    help
      Say m here if you have a KnoxVault2.
      If unsure, say N.
```

## kernel/kernel_device_modules-6.6/drivers/misc/mediatek/fingerprint/Kconfig
```kconfig
# SPDX-License-Identifier: GPL-2.0

config MTK_FINGERPRINT_SUPPORT
	tristate "MTK FINGERPRINT SUPPORT"
	help
	  Fingerprint config for fingerprint feature in project.
	  Please say Y here if you want to support and sensors
	  with mediatek fingerprint architecture.
	  If unsure, say N.

source "$(KCONFIG_EXT_PREFIX)drivers/misc/mediatek/fingerprint/fingerprint_O22/Kconfig"
source "$(KCONFIG_EXT_PREFIX)drivers/misc/mediatek/fingerprint/fingerprint_O8/Kconfig"
```

## kernel/kernel_device_modules-6.6/drivers/misc/mediatek/fingerprint/fingerprint_O22/Kconfig
```kconfig
# SPDX-License-Identifier: GPL-2.0

config MTK_FINGERPRINT_O22_SUPPORT
    tristate "O22 Fingerprint support"
    help
        Fingerprint mtk driver enable/disable
        in the kernel.Say Y here if you want to
        use mediatek fingerprint driver,fingerprint
        driver will support fingerprint function

config MTK_FINGERPRINT_SELECT
    string "sensor type"
    default "GF318M"

source "$(KCONFIG_EXT_PREFIX)drivers/misc/mediatek/fingerprint/fingerprint_O22/silead/Kconfig"
source "$(KCONFIG_EXT_PREFIX)drivers/misc/mediatek/fingerprint/fingerprint_O22/focaltech/Kconfig"
source "$(KCONFIG_EXT_PREFIX)drivers/misc/mediatek/fingerprint/fingerprint_O22/cdfinger/Kconfig"
```

## kernel/kernel_device_modules-6.6/drivers/misc/mediatek/fingerprint/fingerprint_O8/Kconfig
```kconfig
# SPDX-License-Identifier: GPL-2.0

config MTK_FINGERPRINT_O8_SUPPORT
    tristate "O8 Fingerprint support"
    help
        Fingerprint mtk driver enable/disable
        in the kernel.Say Y here if you want to
        use mediatek fingerprint driver,fingerprint
        driver will support fingerprint function

config MTK_FINGERPRINT_SELECT
    string "sensor type"
    default "GF318M"

source "$(KCONFIG_EXT_PREFIX)drivers/misc/mediatek/fingerprint/fingerprint_O8/silead/Kconfig"
source "$(KCONFIG_EXT_PREFIX)drivers/misc/mediatek/fingerprint/fingerprint_O8/jiiov/Kconfig"
source "$(KCONFIG_EXT_PREFIX)drivers/misc/mediatek/fingerprint/fingerprint_O8/focaltech/Kconfig"
```

## kernel/kernel_device_modules-6.6/drivers/misc/mediatek/sensor/1.0/Kconfig
```kconfig
# SPDX-License-Identifier: GPL-2.0

menu "Sensors"

config MTK_SENSOR_ARCHITECTURE
	string "MTK SENSOR ARCHITECTURE"
	default "dummy"
	help
	  Sensor config for sensor architecture in project.
	  Please set 1.0/2.0/3.0 etc if you want to support sensor
	  with mediatek sensor architecture.
	  If unsure, set dummy.
endmenu # Sensors

source "$(KCONFIG_EXT_PREFIX)drivers/misc/mediatek/sensor/1.0/accelerometer/Kconfig"
source "$(KCONFIG_EXT_PREFIX)drivers/misc/mediatek/sensor/1.0/alsps/Kconfig"
source "$(KCONFIG_EXT_PREFIX)drivers/misc/mediatek/sensor/1.0/gyroscope/Kconfig"
source "$(KCONFIG_EXT_PREFIX)drivers/misc/mediatek/sensor/1.0/magnetometer/Kconfig"
source "$(KCONFIG_EXT_PREFIX)drivers/misc/mediatek/sensor/1.0/hwmon/Kconfig"
source "$(KCONFIG_EXT_PREFIX)drivers/misc/mediatek/sensor/1.0/barometer/Kconfig"
source "$(KCONFIG_EXT_PREFIX)drivers/misc/mediatek/sensor/1.0/step_counter/Kconfig"
source "$(KCONFIG_EXT_PREFIX)drivers/misc/mediatek/sensor/1.0/situation/Kconfig"
source "$(KCONFIG_EXT_PREFIX)drivers/misc/mediatek/sensor/1.0/sensorHub/Kconfig"
source "$(KCONFIG_EXT_PREFIX)drivers/misc/mediatek/sensor/1.0/sensorfusion/Kconfig"
# a06 code for SR-AL7160V-01-27 by zhawei at 20240823 start
source "$(KCONFIG_EXT_PREFIX)drivers/misc/mediatek/sensor/1.0/o8_sar/Kconfig"
# a06 code for SR-AL7160V-01-27 by zhawei at 20240823 end
# a14 code for SR-AL6528V-01-185 by hefan at 20240827 start
source "$(KCONFIG_EXT_PREFIX)drivers/misc/mediatek/sensor/1.0/o22_sar/Kconfig"
# a14 code for SR-AL6528V-01-185 by hefan at 20240827 end
```

## kernel/kernel_device_modules-6.6/drivers/misc/mediatek/sensor/1.0/o22_sar/Kconfig
```kconfig
config SENSORS
    bool "Sensors Class Support"
    help
      This option enables the sensor sysfs class in /sys/class/sensors.
      You'll need this to do anything useful with sensorss. If unsure, say N.

config CUSTOM_KERNEL_SAR_SENSOR
    tristate "KERNEL SAR"
    help
      If the platform is supported for sar, this
      configuration should be configured, and the sar
      driver configuration should be configured as well.

config INPUT_SX933X
    tristate "SX933X SAR"
    help
      If contain sx933x sar, this
      configuration should be configured, and the sar
      driver configuration should be configured as well.
```

## kernel/kernel_device_modules-6.6/drivers/misc/mediatek/sensor/1.0/o8_sar/Kconfig
```kconfig
config CUSTOM_KERNEL_O8_SAR
    tristate "KERNEL SAR"
    help
      If the platform is supported for sar, this
      configuration should be configured, and the sar
      driver configuration should be configured as well.

config INPUT_SX933X
    tristate "SX933X SAR"
    help
      If contain sx933x sar, this
      configuration should be configured, and the sar
      driver configuration should be configured as well.

config INPUT_HX9031AS
    tristate "HX9031AS SAR"
    help
      If contain hx9031as sar, this
      configuration should be configured, and the sar
      driver configuration should be configured as well.
```
