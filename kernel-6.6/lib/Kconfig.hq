## kernel/kernel_device_modules-6.6/drivers/misc/mediatek/sensor/1.0/situation/situation_hub/Kconfig
```kconfig
source "$(KCONFIG_EXT_PREFIX)drivers/misc/mediatek/sensor/1.0/situation/situation_hub/stationary/Kconfig"
source "$(KCONFIG_EXT_PREFIX)drivers/misc/mediatek/sensor/1.0/situation/situation_hub/inpocket/Kconfig"
source "$(KCONFIG_EXT_PREFIX)drivers/misc/mediatek/sensor/1.0/situation/situation_hub/wake_gesture/Kconfig"
source "$(KCONFIG_EXT_PREFIX)drivers/misc/mediatek/sensor/1.0/situation/situation_hub/glance_gesture/Kconfig"
source "$(KCONFIG_EXT_PREFIX)drivers/misc/mediatek/sensor/1.0/situation/situation_hub/answercall/Kconfig"
source "$(KCONFIG_EXT_PREFIX)drivers/misc/mediatek/sensor/1.0/situation/situation_hub/pickup_gesture/Kconfig"
source "$(KCONFIG_EXT_PREFIX)drivers/misc/mediatek/sensor/1.0/situation/situation_hub/device_orientation/Kconfig"
source "$(KCONFIG_EXT_PREFIX)drivers/misc/mediatek/sensor/1.0/situation/situation_hub/motion_detect/Kconfig"
source "$(KCONFIG_EXT_PREFIX)drivers/misc/mediatek/sensor/1.0/situation/situation_hub/tilt_detector/Kconfig"
source "$(KCONFIG_EXT_PREFIX)drivers/misc/mediatek/sensor/1.0/situation/situation_hub/flat/Kconfig"
source "$(KCONFIG_EXT_PREFIX)drivers/misc/mediatek/sensor/1.0/situation/situation_hub/sar/Kconfig"
#a06 code for SR-AL7160V-01-44 by liuyiying at 20240830 start
source "$(KCONFIG_EXT_PREFIX)drivers/misc/mediatek/sensor/1.0/situation/situation_hub/smart_alert/Kconfig"
#a06 code for SR-AL7160V-01-44 by liuyiying at 20240830 end
#a06 code for SR-AL7160V-01-43 by xiayujie at 20240906 start
source "$(KCONFIG_EXT_PREFIX)drivers/misc/mediatek/sensor/1.0/situation/situation_hub/wakeup_motion/Kconfig"
#a06 code for SR-AL7160V-01-43 by xiayujie at 20240906 end
```

## kernel/kernel_device_modules-6.6/drivers/misc/mediatek/ssdev_in_mtk/typec/slsi/Kconfig
```kconfig
source "$(KCONFIG_EXT_PREFIX)drivers/misc/mediatek/ssdev_in_mtk/typec/slsi/common/Kconfig"
source "$(KCONFIG_EXT_PREFIX)drivers/misc/mediatek/ssdev_in_mtk/typec/slsi/s2mu107/Kconfig"
source "$(KCONFIG_EXT_PREFIX)drivers/misc/mediatek/ssdev_in_mtk/typec/slsi/s2mu106/Kconfig"
```

## kernel/kernel_device_modules-6.6/drivers/misc/mediatek/typec/tcpc/Kconfig
```kconfig
#
# TypeC Port Controller Device Configuration
#

config TCPC_CLASS
	tristate "TypeC Port Controller Device Class"
	select MTK_USB_TYPEC
	select RT_REGMAP
	select TYPEC
	help
	  Say Y to enable
	  Typec Port
	  Controller Device
	  Class

config USB_POWER_DELIVERY
	tristate "Support USB power delivery Function"
	depends on TCPC_CLASS
	default n
	help
	  Say Y to enable
	  USB
	  Power Delivery
	  support

config TCPC_RT1711H
	tristate "Richtek RT1711H TypeC port Controller Driver"
	depends on TCPC_CLASS
	default n
	help
	  Say Y to enable
	  Richtek RT1711H
	  TypeC port Controller
	  Driver

config TCPC_MT6360
	tristate "MediaTek MT6360 TypeC port Controller Driver"
	depends on TCPC_CLASS
	help
	  Say Y to enable MediaTek MT6360
	  TypeC port Controller
	  Also Support Power Delivery
	  Say N to disable

config TCPC_MT6370
	tristate "MediaTek MT6370 TypeC port Controller Driver"
	depends on TCPC_CLASS
	default n
	help
	  Say Y to enable MediaTek MT6370
	  TypeC port Controller
	  Also Support Power Delivery
	  Say N to disable

# A06_V code for SR-AL7160V-01-132 by xiongxiaoliang at 20240820 start
config TCPC_CPS8851
	tristate "CPS8851 TypeC port Controller Driver"
	depends on TCPC_CLASS
	default n
	help
	  Say Y to enable
	  CPS8851
	  TypeC port Controller
	  Driver

config TCPC_WUSB3812
	tristate "WUSB3812 TypeC port Controller Driver"
	depends on TCPC_CLASS
	default n
	help
	  Say Y to enable
	  CPS8851
	  TypeC port Controller
	  Driver
# A06_V code for SR-AL7160V-01-132 by xiongxiaoliang at 20240820 end

# A06_V code for SR-AL7160V-01-133 by yexuedong at 20240829 start
config TCPC_UPM6922P
	tristate "Unisemipower UPM6922P TypeC port Controller Driver"
	depends on TCPC_CLASS
	default n
	help
	  Say Y to enable
	  Unisemipower UPM6922P
	  TypeC port Controller
	  Driver
# A06_V code for SR-AL7160V-01-133 by yexuedong at 20240829 end

# A06_V code for SR-AL7160V-01-135 by yexuedong at 20240827 start
config TCPC_UPM7610
	tristate "Unisemipower UPM7610 TypeC port Controller Driver"
	depends on TCPC_CLASS
	default n
	help
	  Say Y to enable
	  Unisemipower UPM7610
	  TypeC port Controller
	  Driver
# A06_V code for SR-AL7160V-01-135 by yexuedong at 20240827 end

# A14_V code for SR-AL6528V-01-117 by gaoxugang at 20240827 start
config TCPC_HUSB311
    tristate "HUSB31 TypeC port Controller Driver"
    depends on TCPC_CLASS
    default n
    help
      Say Y to enable
      HUSB311
      TypeC port Controller
      Driver

config HUSB_REGMAP
    tristate "regmap"
    default n
    help
      Say Y to enable HUSB_REGMAP
      information
      Say N to disable
# A14_V code for SR-AL6528V-01-117 by gaoxugang at 20240827 end

# A14 code for SR-AL6528V-01-119 by gaoxugang at 20240903 start
config TCPC_ET7304
	tristate "ETEK ET7304 TypeC port Controller Driver"
	depends on TCPC_CLASS
	default n
	help
	  Say Y to enable
	  ETEK ET7304
	  TypeC port Controller
	  Driver

config ET_REGMAP
	tristate "regmap"
	default n
	help
	  Say Y to enable ET_REGMAP
	  information
	  Say N to disable
# A14 code for SR-AL6528V-01-119 by gaoxugang at 20240903 end

config TCPC_MT6375
	tristate "Mediatek MT6375 compatible Type-C chip driver"
	depends on TCPC_CLASS
	depends on MFD_MT6375
	help
	  Say Y to enable MediaTek MT6375
	  Mediatek MT6375 Type-C chip driver that works with
	  Type-C Port Controller Manager to provide USB PD and USB
	  Type-C functionalities.

config TCPC_MT6379
	tristate "Mediatek MT6379 compatible Type-C chip driver"
	depends on TCPC_CLASS
	depends on MFD_MT6379_I2C || MFD_MT6379_SPMI
	help
	  Say Y to enable MediaTek MT6375/MT6379
	  Mediatek MT6375/MT6379 Type-C chip driver that works with
	  Type-C Port Controller Manager to provide USB PD and USB
	  Type-C functionalities.

config USB_PD_VBUS_STABLE_TOUT
	int "PD VBUS Stable Timeout"
	depends on USB_POWER_DELIVERY
	range 0 1000                       # >= 0,  <= 1000
	default 125
	help
	  Setup a timeout value (ms)
	  for
	  VBUS change
	  stable

config PD_DBG_INFO
	tristate "PD debug information"
	depends on TCPC_CLASS
	default y
	help
	  Say Y to enable PD debug
	  for PD DBG
	  information
	  Say N to disable

config MTK_TYPEC_WATER_DETECT
	tristate "Water detection function for type-c connector"
	depends on TCPC_CLASS
	help
	  Say Yes to enable water detection on type-c connector.
	  If water is detected on the connector, it will show
	  warning to notify end user.
	  If unsure, say N.

config MTK_TYPEC_WATER_DETECT_BY_PCB
	tristate "Let PCB decides enabling water detection or not"
	depends on MTK_TYPEC_WATER_DETECT
	help
	  Query GPIO on PCB to judge whether type-c water detection
	  need to be enabled.
	  Say Yes to let PCB decides enabling water detection or not.
	  If unsure, say N.

# A14 code for SR-AL6528V-01-115 by gaoxugang at 20240911 start
if HQ_PROJECT_O22
# source "$(KCONFIG_EXT_PREFIX)drivers/misc/mediatek/typec/tcpc/tcpc_fusb302b/Platform_Linux/
# A14 code for SR-AL6528V-01-48 by gaoxugang at 20240929 start
source "$(KCONFIG_EXT_PREFIX)drivers/misc/mediatek/typec/tcpc/tcpc_aw35615/Kconfig"
# A14 code for SR-AL6528V-01-48 by gaoxugang at 20240929 end
endif
# A14 code for SR-AL6528V-01-115 by gaoxugang at 20240911 end
```

## kernel/kernel_device_modules-6.6/drivers/misc/mediatek/typec/tcpc/tcpc_fusb302b/Platform_Linux/Kconfig
```kconfig
config TYPEC_FUSB302B
	tristate "TYPEC_FUSB302 driver"
	default m
	help
	  Say Y or M here if your system has fusb302 ic controller.
```

## kernel/kernel_device_modules-6.6/drivers/power/supply/afc/Kconfig
```kconfig
config AFC_CHARGER
	tristate "Using AFC device driver"
	default n
	help
	  If you say yes here you will get support for
	  the AFC device driver.
```

## kernel/kernel_device_modules-6.6/drivers/power/supply/charge_pump/Kconfig
```kconfig
config CHARGER_CP_PPS
	tristate "charge pump pps support"
	default n
	help
	  Say Y to enable support for charge pump pps

config UPM6720_CP
	tristate "UPM6720 CP"
	depends on MTK_CHARGER
	help
	  Say Yes to enable
	  UPM6720 driver.

# A06_V code for SR-AL7160V-01-135|SR-AL7160V-01-136 by xiongxiaoliang at 20240902 start
config NU2115A_CP
	tristate "NU2115A CP"
	depends on MTK_CHARGER
	help
	  Say Yes to enable
	  NU2115A driver.

config SGM41606S_CP
	tristate "SGM41606S CP"
	depends on MTK_CHARGER
	help
	  Say Yes to enable
	  SGM41606S driver.

config NX853X_CP
	tristate "NX853X CP"
	depends on MTK_CHARGER
	help
	  Say Yes to enable
	  NX853X driver.
# A06_V code for SR-AL7160V-01-135|SR-AL7160V-01-136 by xiongxiaoliang at 20240902 end
```
